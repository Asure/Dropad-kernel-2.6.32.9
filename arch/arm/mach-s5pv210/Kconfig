## arch/arm/mach-s5pv210/Kconfig
```kconfig
# arch/arm/mach-s5pv210/Kconfig
#
# Copyright (c) 2010 Samsung Electronics Co., Ltd.
#		http://www.samsung.com/
#
# Licensed under GPLv2

# Configuration options for the S5PV210/S5PC110

if ARCH_S5PV210

config CPU_S5PV210
	bool
	select PLAT_S5P
	select S5PV210_PM if PM
	help
	  Enable S5PV210 CPU support

choice
	prompt "Select machine type"
	depends on ARCH_S5PV210
	default MACH_MANGO210

config MACH_MANGO210
	bool "MANGO210"
	select CPU_S5PV210
	select ARCH_SPARSEMEM_ENABLE
	select S3C_DEV_HSMMC
	select S3C_DEV_HSMMC1 if !S5PV210_SD_CH0_8BIT
	select S3C_DEV_HSMMC2
	select S3C_DEV_HSMMC3 if !S5PV210_SD_CH2_8BIT
	select S5PV210_SETUP_SDHCI
	select PCI
	help
	  Machine support for Crztech MANGO210


config MACH_SMDKV210
	bool "SMDKV210"
	select CPU_S5PV210
	select ARCH_SPARSEMEM_ENABLE
	select S3C_DEV_HSMMC
	select S3C_DEV_HSMMC1 if !S5PV210_SD_CH0_8BIT
	select S3C_DEV_HSMMC2
	select S3C_DEV_HSMMC3 if !S5PV210_SD_CH2_8BIT
	select S5PV210_SETUP_SDHCI
	select PCI
	help
	  Machine support for Samsung SMDKV210

config MACH_SMDKC110
	bool "SMDKC110"
	select CPU_S5PV210
	select DISCONTIGMEM
	select S3C_DEV_HSMMC
	select S3C_DEV_HSMMC1 if !S5PV210_SD_CH0_8BIT
	select S3C_DEV_HSMMC2
	select S3C_DEV_HSMMC3 if !S5PV210_SD_CH2_8BIT
	select S5PV210_SETUP_SDHCI
	select ARCH_DISCONTIGMEM_ENABLE
	select PCI
	help
	  Machine support for Samsung SMDKC110
	  S5PC110(MCP) is one of package option of S5PV210

endchoice

choice
	prompt "Board revision"
	depends on MACH_MANGO210
	default MACH_MANGO210_EVT1

config MACH_MANGO210_EVT0
	bool "EVT0"
	help
	  Support EVT0

config MACH_MANGO210_EVT1
	bool "EVT1"
	help
	  Support EVT1
endchoice
choice
        prompt "WiFi Module Select "
        depends on MACH_MANGO210
        default MANGO_WIFI_CSR

config MANGO_WIFI_CSR
        bool "WiFi CSR"
        help
          Support CSR

config MANGO_WIFI_W2CBW003
        bool "WiFi W2CBW003"
        help
          Support W2CBW003
endchoice

choice
	prompt "Select DMC0 memory type for S5PC110"
	depends on MACH_SMDKC110
	default S5PC110_MEM_DMC0_ONEDRAM

config S5PC110_MEM_DMC0_ONEDRAM
	bool "OneDRAM"
	help
	  If you have S5PC110 B-Type or D-Type, select it

config S5PC110_MEM_DMC0_MDDR
	bool "mDDR"
	help
	  if you have S5PC110 H-Type or N-Type, select it

endchoice

choice
	prompt "CPU revision"
	depends on CPU_S5PV210
	default CPU_S5PV210_EVT1

config CPU_S5PV210_EVT0
	bool "EVT0"
	help
	  Support EVT0

config CPU_S5PV210_EVT1
	bool "EVT1"
	help
	  Support EVT1
endchoice

config DM9000_16BIT
	bool "DM9000 16-bit"
	depends on MACH_SMDKV210 || MACH_VOGUEV210 || MACH_SMDKC110
	default n
	help
	  Support DM9000 ethernet controller with 16bit data bus

config S5PV210_PM
	bool
	help
	  Power Management code common to S5PV210

config S5PV210_SETUP_FB_S3C
	bool
	default y
	help
	  Setup code for S5PV210 FIMD

config S5PV210_SETUP_FIMC0
	bool
	default y
	help
	  Common setup code for FIMC controller 0.

config S5PV210_SETUP_FIMC1
	bool
	default y
	help
	  Common setup code for FIMC controller 1.

config S5PV210_SETUP_FIMC2
	bool
	default y
	help
	  Common setup code for FIMC controller 2.

config S5PV210_SETUP_CSIS
	bool
	default y
	help
	  Common setup code for MIPI-CSIS


config S5PV210_SETUP_SDHCI
	bool
	depends on PLAT_S5P
	default y
	help
	  Internal helper functions for S5PCV210 based SDHCI systems

comment "MMC/SD slot setup"
depends on PLAT_S5P

menu "Use 8-bit bus width"
config S5PV210_SD_CH0_8BIT
bool "Channel 0"
depends on PLAT_S5P
default n
help
IF channel 0 uses 8-bit bus, channel 1 is disabled.

config S5PV210_SD_CH2_8BIT
bool "Channel 2"
depends on PLAT_S5P
default n
help
IF channel 2 uses 8-bit bus, channel 3 is disabled.
endmenu

menu "Use dynamic clock gating"
config MMC_CH0_CLOCK_GATING
	bool "Channel 0"
	depends on S3C_DEV_HSMMC
	default n
	help
		This feature turns off clock of channel 0
		for power saving when MMC/SD cards are not used.
config MMC_CH1_CLOCK_GATING
	bool "Channel 1"
	depends on S3C_DEV_HSMMC1
	default n
	help
		This feature turns off clock of channel 1
		for power saving when MMC/SD cards are not used.
config MMC_CH2_CLOCK_GATING
	bool "Channel 2"
	depends on S3C_DEV_HSMMC2
	default n
	help
		This feature turns off clock of channel 2
		for power saving when MMC/SD cards are not used.
config MMC_CH3_CLOCK_GATING
	bool "Channel 3"
	depends on S3C_DEV_HSMMC3
	default n
	help
		This feature turns off clock of channel 3
		for power saving when MMC/SD cards are not used.
endmenu

# platform specific device setup
# ADC part
config S5PV210_ADC
        bool "S5PV210_ ADC Driver"
        depends on CPU_S5PV210
        help
          ADC (A/D Conversion) driver for Samsung S5PV210.

endif
```

## arch/arm/plat-s5p/Kconfig
```kconfig
# arch/arm/plat-s5p/Kconfig
#
# Copyright (c) 2009 Samsung Electronics Co., Ltd.
#		http://www.samsung.com/
#
# Licensed under GPLv2

config PLAT_S5P
	bool
	depends on (ARCH_S5P6440 || ARCH_S5P6442 || ARCH_S5PV210)
	default y
	select ARM_VIC
	select NO_IOPORT
	select ARCH_REQUIRE_GPIOLIB
	select S3C_GPIO_TRACK
	select SAMSUNG_GPIOLIB_4BIT
	select S3C_GPIO_CFG_S3C64XX
	select S3C_GPIO_PULL_UPDOWN
	select S3C_GPIO_CFG_S3C24XX
	select PLAT_SAMSUNG
	select SAMSUNG_CLKSRC
	select SAMSUNG_IRQ_VIC_TIMER
	select SAMSUNG_IRQ_UART
	help
	  Base platform code for Samsung's S5P series SoC.

config SYSTIMER_S5P
	bool
	depends on (ARCH_S5P6442 || ARCH_S5PV210)
	default y
	help
	  Support System Timer for S5P Series

config S5P_HIGH_RES_TIMERS
        bool "HRtimer and Dynamic Tick support"
        select GENERIC_TIME
        select GENERIC_CLOCKEVENTS
        select HIGH_RES_TIMERS
        default n
        help
          Support for HRtimer and Dynamic Tick system.
	  
choice
        prompt "Select HRT source timer"
        depends on S5P_HIGH_RES_TIMERS
        default HRT_RTC

#config HRT_PWM
#        bool "PWM timers(2/4) (Not yet)"
#        help
#          PWM timers are used as HRT
config HRT_RTC
        bool "RTC/SYSTEM TIMER"
        help
          RTC and System timer are used as HRT
endchoice

config S5P_DMA_PL330
	bool
	depends on ARCH_S5PV210
	default y
	help
	  Support DMA PL330 for all SAMSUNG S5P SOCs.

choice
	prompt "Select PL330 DMA Driver"
	depends on S5P_DMA_PL330
	
config OLD_DMA_PL330
	bool "OLD S3C DMA Driver"

config NEW_DMA_PL330
	bool "NEW S3C DMA Driver"
	select PL330
	
endchoice

config S5P_SETUP_I2C0
	bool
	default y
	help
	  Common setup code for i2c bus 0.

config S5P_SETUP_I2C1
	bool
	default y
	help
	  Common setup code for i2c bus 1.

config S5P_SETUP_I2C2
	bool
	default y
	help
	  Common setup code for i2c bus 2.

# MFC part
config S5P_DEV_MFC
	bool
	default y
	help
	  Compile in platform device definitions for MFC

config S5P_SETUP_MFC
	bool
	default y
	help
	  Common setup code for MFC

config S5P_LPAUDIO
	bool "Support S5P Low Power(LP) Audio"
	depends on (CPU_IDLE && PM && SND_S3C_I2SV2_SOC)
	default y
	help
	  s5p low power audio enable / disable
```

## drivers/crzboys/Kconfig
```kconfig
#
# Crzboys configuration
#

menuconfig CRZBOYS
	tristate "Crzboys support"
	default n
	help
	  This enables support Crztech Controller

if CRZBOYS

config CRZBOYS_MEM_DBG
	bool "Crzboys Memory Debuger"
	default n

endif
```
